## config/west.yml
```yaml
manifest:
  remotes:
    - name: zmkfirmware
      url-base: https://github.com/zmkfirmware
    - name: zmkfirmware-infused-kim
      url-base: https://github.com/infused-kim
    - name: zmkfirmware-split-battery-report
      url-base: https://github.com/Katona/
    - name: luna
      url-base: https://github.com/pitchayath/
    - name: urob
      url-base: https://github.com/urob
    - name: nguyendown
      url-base: https://github.com/nguyendown
  projects:
    - name: zmk
      remote: nguyendown
      revision: display/bongo-cat-widget
      import: app/west.yml
  self:
    path: config
```
